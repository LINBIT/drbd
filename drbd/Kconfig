## drbd/Kconfig
```kconfig
#
# DRBD device driver configuration
#

comment "DRBD disabled because PROC_FS, INET or CONNECTOR not selected"
	depends on !PROC_FS || !INET || !CONNECTOR

config BLK_DEV_DRBD
	tristate "DRBD Distributed Replicated Block Device support"
	depends on PROC_FS && INET && CONNECTOR
	help

	  NOTE: In order to authenticate connections you have to select
	  CRYPTO_HMAC and a hash function as well.

	  DRBD is a shared-nothing, synchronously replicated block device. It
	  is designed to serve as a building block for high availability
	  clusters and in this context, is a "drop-in" replacement for shared
	  storage. Simplistically, you could see it as a network RAID 1.

	  Each minor device has a role, which can be 'primary' or 'secondary'.
	  On the node with the primary device the application is supposed to
	  run and to access the device (/dev/drbdX). Every write is sent to
	  the local 'lower level block device' and, across the network, to the
	  node with the device in 'secondary' state.  The secondary device
	  simply writes the data to its lower level block device.

	  DRBD can also be used in dual-Primary mode (device writable on both
	  nodes), which means it can exhibit shared disk semantics in a
	  shared-nothing cluster.  Needless to say, on top of dual-Primary
	  DRBD utilizing a cluster file system is necessary to maintain for
	  cache coherency.

	  For automatic failover you need a cluster manager (e.g. heartbeat).
	  See also: http://www.drbd.org/, http://www.linux-ha.org

	  If unsure, say N.
```

## drbd/drbd/Kconfig
```kconfig
#
# DRBD device driver configuration
#
config BLK_DEV_DRBD
	tristate "Distributed redundant block device support"
	select INET
	select PROC_FS
	---help---
	  Drbd is a block device which is designed to build high availability
	  clusters.  This is done by mirroring a whole block device via (a
	  dedicated) network.  You could see it as a network RAID 1.

	  This device replaces the regular "network block device".

	  Each device (drbd provides more than one of these devices) has a
	  state, which can be 'primary' or 'secondary'. On the node with the
	  primary device the application is supposed to run and to access the
	  device (/dev/nbX). Every write is sent to the local 'lower level
	  block device' and to the node with the device in 'secondary' state.
	  The secondary device simply writes the data to its lower level block
	  device. Reads are always carried out locally.

	  Drbd management is done through user-space tools.

	  http://www.drbd.org/

	  If unsure, say N.

comment "DRBD in kernel, no NBD possible"
	depends on BLK_DEV_DRBD=y

comment "Note: you can _not_ load both NBD and DRBD modules at the same time"
	depends on BLK_DEV_DRBD && BLK_DEV_NBD
```
